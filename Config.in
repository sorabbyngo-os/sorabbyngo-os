## Config.in
```kconfig
menu "Sorabbyngo OS packages"
	source "$BR2_EXTERNAL_SORABBYNGO_PATH/package/sorabbyngo-sentinel/Config.in"
	source "$BR2_EXTERNAL_SORABBYNGO_PATH/package/sorabbyngo-chameha/Config.in"
	source "$BR2_EXTERNAL_SORABBYNGO_PATH/package/sorabbyngo-nats/Config.in"
	source "$BR2_EXTERNAL_SORABBYNGO_PATH/package/sorabbyngo-linux/Config.in"
endmenu
```

## configs/sorabbyngo_x86_64_defconfig
```kconfig
# Architecture
BR2_x86_64=y
BR2_x86_corei7=y

# Toolchain
BR2_TOOLCHAIN_BUILDROOT_GLIBC=y
BR2_TOOLCHAIN_BUILDROOT_CXX=y
BR2_KERNEL_HEADERS_6_18=y

# Kernel

# Init system
BR2_INIT_SYSTEMD=y

# System
BR2_TARGET_GENERIC_HOSTNAME="sorabbyngo"
BR2_TARGET_GENERIC_ISSUE="Sorabbyngo OS — Rhythm of Digital Life"
BR2_TARGET_GENERIC_ROOT_PASSWD="sorabbyngo"
BR2_TARGET_GENERIC_PASSWD_SHA256=y
BR2_ENABLE_LOCALE=y
BR2_GENERATE_LOCALE="en_US.UTF-8 sw_KE.UTF-8"
BR2_SYSTEM_DEFAULT_PATH="/bin:/sbin:/usr/bin:/usr/sbin"
BR2_ROOTFS_SKELETON_DEFAULT=y

# Shell
BR2_PACKAGE_BASH=y
BR2_PACKAGE_BASH_COMPLETION=y

# Python

# Essential packages
BR2_PACKAGE_BUSYBOX=y
BR2_PACKAGE_UTIL_LINUX=y
BR2_PACKAGE_UTIL_LINUX_MOUNT=y
BR2_PACKAGE_E2FSPROGS=y
BR2_PACKAGE_OPENSSH=y
BR2_PACKAGE_WGET=y
BR2_PACKAGE_CA_CERTIFICATES=y

# Filesystem tools
BR2_PACKAGE_DOSFSTOOLS=y
BR2_PACKAGE_PARTED=y

# Hardware support
BR2_PACKAGE_PCIUTILS=y
BR2_PACKAGE_USBUTILS=y

# Rootfs
BR2_ROOTFS_OVERLAY="$(BR2_EXTERNAL_SORABBYNGO_PATH)/board/sorabbyngo/overlay"
BR2_ROOTFS_POST_BUILD_SCRIPT="$(BR2_EXTERNAL_SORABBYNGO_PATH)/board/sorabbyngo/post-build.sh"
BR2_ROOTFS_POST_IMAGE_SCRIPT="$(BR2_EXTERNAL_SORABBYNGO_PATH)/board/sorabbyngo/post-image.sh"

# Output formats
BR2_TARGET_ROOTFS_EXT2=y
BR2_TARGET_ROOTFS_EXT2_4=y
BR2_TARGET_ROOTFS_EXT2_SIZE="2G"
BR2_TARGET_ROOTFS_ISO9660=y
BR2_TARGET_ROOTFS_ISO9660_HYBRID=y

# Bootloader
BR2_TARGET_GRUB2=y
BR2_TARGET_GRUB2_X86_64_EFI=y
BR2_TARGET_GRUB2_BUILTIN_MODULES="boot linux ext2 fat serial part_msdos part_gpt normal iso9660 gzio"
# BR2_LEGACY is not set
BR2_PACKAGE_SORABBYNGO_LINUX=y
BR2_PACKAGE_SORABBYNGO_NATS=y
BR2_PACKAGE_SORABBYNGO_SENTINEL=y
BR2_PACKAGE_SORABBYNGO_CHAMEHA=y

# Kernel
BR2_LINUX_KERNEL=y
BR2_LINUX_KERNEL_CUSTOM_TARBALL=y
BR2_LINUX_KERNEL_CUSTOM_TARBALL_LOCATION="file:///home/sorabbyngo/sorabbyngo-output/dl/linux/linux-6.19.10-sorabbyngo.tar.gz"
BR2_LINUX_KERNEL_USE_CUSTOM_CONFIG=y
BR2_LINUX_KERNEL_CUSTOM_CONFIG_FILE="/home/sorabbyngo/sorabbyngo-patches/sorabbyngo.config"
BR2_LINUX_KERNEL_NEEDS_HOST_OPENSSL=y
BR2_TOOLCHAIN_BUILDROOT_GLIBC=y
BR2_TOOLCHAIN_BUILDROOT_CXX=y
BR2_JLEVEL=1
```

## os/kernel/configs/sorabbyngo_x86_64_defconfig
```kconfig
# Architecture
BR2_x86_64=y
BR2_x86_corei7=y

# Toolchain
BR2_TOOLCHAIN_BUILDROOT_GLIBC=y
BR2_TOOLCHAIN_BUILDROOT_CXX=y
BR2_KERNEL_HEADERS_6_6=y
BR2_TOOLCHAIN_GCC_AT_LEAST_12=y

# External kernel — use our 6.19.10-sorabbyngo
BR2_LINUX_KERNEL=n

# Init system
BR2_INIT_SYSTEMD=y
BR2_TARGET_GENERIC_HOSTNAME="sorabbyngo"
BR2_TARGET_GENERIC_ISSUE="Sorabbyngo OS — Rhythm of Digital Life"
BR2_TARGET_GENERIC_ROOT_PASSWD="sorabbyngo"
BR2_TARGET_GENERIC_PASSWD_SHA256=y

# System
BR2_ENABLE_LOCALE=y
BR2_GENERATE_LOCALE="en_US.UTF-8 sw_KE.UTF-8"
BR2_SYSTEM_DEFAULT_PATH="/bin:/sbin:/usr/bin:/usr/sbin"
BR2_ROOTFS_SKELETON_DEFAULT=y

# Shell
BR2_PACKAGE_BASH=y
BR2_PACKAGE_BASH_COMPLETION=y

# Python 3.12
BR2_PACKAGE_PYTHON3=y
BR2_PACKAGE_PYTHON3_PY_PYC=y
BR2_PACKAGE_PYTHON_PIP=y
BR2_PACKAGE_PYTHON3_SSL=y

# Essential packages
BR2_PACKAGE_BUSYBOX=y
BR2_PACKAGE_UTIL_LINUX=y
BR2_PACKAGE_UTIL_LINUX_MOUNT=y
BR2_PACKAGE_E2FSPROGS=y
BR2_PACKAGE_OPENSSH=y
BR2_PACKAGE_WGET=y
BR2_PACKAGE_CA_CERTIFICATES=y
BR2_PACKAGE_DHCPCD=y
BR2_PACKAGE_IPROUTE2=y

# Filesystem tools
BR2_PACKAGE_DOSFSTOOLS=y
BR2_PACKAGE_PARTED=y

# Hardware support
BR2_PACKAGE_PCIUTILS=y
BR2_PACKAGE_USBUTILS=y

# Sorabbyngo rootfs overlay
BR2_ROOTFS_OVERLAY="board/sorabbyngo/overlay"

# Post build script
BR2_ROOTFS_POST_BUILD_SCRIPT="board/sorabbyngo/post-build.sh"
BR2_ROOTFS_POST_IMAGE_SCRIPT="board/sorabbyngo/post-image.sh"

# Output formats
BR2_TARGET_ROOTFS_EXT2=y
BR2_TARGET_ROOTFS_EXT2_4=y
BR2_TARGET_ROOTFS_EXT2_SIZE="2G"
BR2_TARGET_ROOTFS_ISO9660=y
BR2_TARGET_ROOTFS_ISO9660_HYBRID=y
BR2_TARGET_ROOTFS_ISO9660_BOOT_MENU=""

# GRUB2 bootloader
BR2_TARGET_GRUB2=y
BR2_TARGET_GRUB2_X86_64_EFI=y
BR2_TARGET_GRUB2_BUILTIN_MODULES="boot linux ext2 fat serial part_msdos part_gpt normal iso9660 gzio"
```

## package/sorabbyngo-chameha/Config.in
```kconfig
config BR2_PACKAGE_SORABBYNGO_CHAMEHA
	bool "sorabbyngo-chameha"
	depends on BR2_PACKAGE_PYTHON3
	help
	  Chameha — AI personality and voice interface.
	  Tier 1 local inference via Ollama. English + Swahili.
```

## package/sorabbyngo-linux/Config.in
```kconfig
config BR2_PACKAGE_SORABBYNGO_LINUX
	bool "sorabbyngo-linux"
	default y
	help
	  Linux 6.19.10 with Sorabbyngo security patches (0001-0017),
	  NodeID driver, and Byngonet mesh network driver.
```

## package/sorabbyngo-nats/Config.in
```kconfig
config BR2_PACKAGE_SORABBYNGO_NATS
	bool "sorabbyngo-nats"
	help
	  NATS server binary for Sorabbyngo OS.
	  Pre-built amd64 binary from nats.io.
	  All Sorabbyngo services communicate over NATS JetStream.
```

## package/sorabbyngo-sentinel/Config.in
```kconfig
config BR2_PACKAGE_SORABBYNGO_SENTINEL
	bool "sorabbyngo-sentinel"
	depends on BR2_PACKAGE_PYTHON3
	select BR2_PACKAGE_PYTHON_NATS_PY
	help
	  Sorabbyngo Sentinel — central watchdog daemon.
	  Audit chain, NodeID verification, service heartbeat monitor.
```
